/dts-v1/;

/ {
    compatible = "zerodroid,dtc-fixture-base";
    #address-cells = <1>;
    #size-cells = <1>;

    soc {
        compatible = "simple-bus";
        #address-cells = <1>;
        #size-cells = <1>;
        ranges;

        serial0: serial@1000 {
            compatible = "ns16550a";
            reg = <0x1000 0x100>;
        };
    };
};
